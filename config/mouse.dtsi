#include <input/processors.dtsi>
#include <zephyr/dt-bindings/input/input-event-codes.h>

/{
  glidepoint_split {
    input-processors = <&zip_xy_scaler 3 2>;
    scroller {
          layers = <1>;
          input-processors = <&zip_xy_to_scroll_mapper>;
          process-next;
      };
  }
}
