#include "cirque.dtsi"

&pro_micro_i2c {
     status = "okay";
     clock-frequency = < 400000 >;
     glidepoint: glidepoint@0 {
         compatible = "cirque,pinnacle";
         reg = <0>;
         status = "okay";
         dr-gpios = <&gpio0 6 (GPIO_ACTIVE_HIGH)>;
         sensitivity = "1x";
         sleep;
         // no-taps;
     };
 };

&glidepoint_split {
    device = <&glidepoint>;
};
