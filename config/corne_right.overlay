#include "cirque.dtsi"

&pro_micro_i2c {
     status = "disabled";
     clock-frequency = < 400000 >;
     cirque: cirque@2a {
         compatible = "cirque,pinnacle";
         reg = <0x2a>;
         status = "disabled";
         dr-gpios = <&gpio0 6 (GPIO_ACTIVE_HIGH)>;
         sensitivity = "1x";
         sleep;
         // no-taps;
     };
 };

&glidepoint_split {
    device = <&cirque>;

    input-processors = <&zip_xy_transform (INPUT_TRANSFORM_XY_SWAP | INPUT_TRANSFORM_X_INVERT | INPUT_TRANSFORM_Y_INVERT)>;
};
