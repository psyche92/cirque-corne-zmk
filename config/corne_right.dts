#include "cirque.dtsi"

&pro_micro_i2c {
     status = "okay";
     clock-frequency = < 400000 >;
     cirque: cirque@2a {
         compatible = "cirque,pinnacle";
         reg = <0x2a>;
         status = "okay";
         dr-gpios = <&gpio0 6 (GPIO_ACTIVE_HIGH)>;
         sensitivity = "1x";
         sleep;
         // no-taps;
     };
 };

&glidepoint_split {
    device = <&cirque>;
};
